## santimqtt/components/mqtt_module/Kconfig
```kconfig
menu "MQTT module"
config MQTT_MODULE_BROKER_URI
    string "Broker URI"
    default "mqtt://broker.hivemq.com:1883"
config MQTT_MODULE_TOPIC_BASE
    string "Tópico raíz"
    default "/santiagoelters/"
endmenu
```

## santimqtt/components/wifi_manager/Kconfig
```kconfig
menu "Kaluga Wi-Fi"

config KM_SSID
    string "Wi-Fi SSID"
    default "caliope"

config KM_PASSWORD
    string "Wi-Fi Password"
    default "sinlugar"

endmenu
```
